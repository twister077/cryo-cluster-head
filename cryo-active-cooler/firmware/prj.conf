## CMakeLists.txt
```
set(BOARD nrf52832dk_nrf52832)
set(CMAKE_C_STANDARD 99)

find_package(Zephyr REQUIRED HINTS $ENV{ZEPHYR_BASE})

project(active-cooler)

target_sources(app PRIVATE
    src/main.c
    src/temp_voter.c
    src/peltier.c
    src/safety.c
    src/auto_mode.c
    src/ble_patch.c
    src/ble_phone.c
)
```

## prj.conf
```kconfig
# General
CONFIG_GPIO=y
CONFIG_PRINTK=y

# I2C (local MAX30205)
CONFIG_I2C=y
CONFIG_I2C_INIT_PRIORITY=60

# BLE Central (read patch + phone)
CONFIG_BT=y
CONFIG_BT_CENTRAL=y
CONFIG_BT_MAX_CONN=2
CONFIG_BT_DEVICE_NAME="CryoCooler"
CONFIG_BT_SCAN=y
CONFIG_BT_SCAN_FILTER_ENABLE=y

# PWM (Peltier control)
CONFIG_PWM=y

# Timer
CONFIG_COUNTER=y
CONFIG_ALARM=y

# ADC (battery monitoring)
CONFIG_ADC=y
```

## src/main.c
```c
#include <zephyr/kernel.h>
#include <zephyr/drivers/i2c.h>
#include <zephyr/bluetooth/bluetooth.h>
#include <zephyr/logging/log.h>

#include "levels.h"
#include "temp_voter.h"
#include "peltier.h"
#include "safety.h"
#include "auto_mode.h"
#include "ble_patch.h"
#include "ble_phone.h"

LOG_MODULE_REGISTER(main, CONFIG_LOG_DEFAULT_LEVEL);

static const struct device *local_i2c;
static int current_mode = MODE_OFF;
static bool cooling_active = false;

#define LOCAL_SENSOR_ADDR 0x48

#define CONTROL_INTERVAL_MS 5000

static int read_local_temp(float *temp)
{
    uint8_t buf[2];
    int ret = i2c_reg_read_byte(local_i2c, LOCAL_SENSOR_ADDR, 0x00, &buf[0]);
    if (ret) return ret;
    ret = i2c_reg_read_byte(local_i2c, LOCAL_SENSOR_ADDR, 0x01, &buf[1]);
    if (ret) return ret;

    uint16_t raw = ((uint16_t)buf[0] << 8) | buf[1];
    raw >>= 3;
    *temp = raw * 0.03125f;
    return 0;
}

static void refresh_temp_sources(void)
{
    float t;

    if (ble_patch_get_temp(&t) == 0) {
        temp_voter_feed(TEMP_SOURCE_PATCH_BLE, t);
    }

    if (ble_phone_get_temp(&t) == 0) {
        temp_voter_feed(TEMP_SOURCE_PHONE_RELAY, t);
    }

    if (read_local_temp(&t) == 0) {
        temp_voter_feed(TEMP_SOURCE_LOCAL, t);
    }
}

static void update_cooling(void)
{
    struct temp_vote_result vote = temp_voter_get_vote();
    int phone_mode = ble_phone_get_mode();

    if (!vote.safe) {
        LOG_WRN("No temp quorum — safe shutdown");
        peltier_off();
        cooling_active = false;
        current_mode = MODE_OFF;
        return;
    }

    if (safety_is_faulted()) {
        LOG_WRN("Safety fault: %s", safety_get_fault_reason());
        peltier_off();
        cooling_active = false;
        current_mode = MODE_OFF;
        return;
    }

    switch (phone_mode) {
    case MODE_OFF:
        if (cooling_active) {
            LOG_INF("Mode: off — stopping");
            peltier_off();
            cooling_active = false;
        }
        current_mode = MODE_OFF;
        break;

    case MODE_L1:
        if (!cooling_active) {
            LOG_INF("Mode: level 1 — start");
            safety_reset_timer();
            cooling_active = true;
        }
        peltier_set_level(MODE_L1);
        current_mode = MODE_L1;
        break;

    case MODE_L2:
        if (!cooling_active) {
            LOG_INF("Mode: level 2 — start");
            safety_reset_timer();
            cooling_active = true;
        }
        peltier_set_level(MODE_L2);
        current_mode = MODE_L2;
        break;

    case MODE_L3:
        if (!cooling_active) {
            LOG_INF("Mode: level 3 — start");
            safety_reset_timer();
            cooling_active = true;
        }
        peltier_set_level(MODE_L3);
        current_mode = MODE_L3;
        break;

    case MODE_AUTO: {
        int target = ble_phone_get_target_temp();
        auto_mode_set_target((float)target);
        bool should_cool = auto_mode_tick(vote.temperature);

        if (should_cool) {
            if (!cooling_active) {
                LOG_INF("Auto mode: cooling to %d°C (current: %.1f°C)",
                        target, vote.temperature);
                safety_reset_timer();
                cooling_active = true;
            }
            peltier_set_level(MODE_L3);
        } else {
            if (cooling_active) {
                LOG_INF("Auto mode: target reached — stopping");
                peltier_off();
                cooling_active = false;
            }
        }
        current_mode = MODE_AUTO;
        break;
    }

    default:
        peltier_off();
        cooling_active = false;
        current_mode = MODE_OFF;
        break;
    }
}

void main(void)
{
    int err;

    local_i2c = DEVICE_DT_GET(DT_NODELABEL(i2c1));
    if (!device_is_ready(local_i2c)) {
        LOG_ERR("Local I2C not ready");
        return;
    }

    err = bt_enable(NULL);
    if (err) {
        LOG_ERR("BLE init failed: %d", err);
        return;
    }

    temp_voter_init();
    peltier_init();
    safety_init();
    auto_mode_init();
    ble_patch_init();
    ble_phone_init();

    LOG_INF("Active Cooler started — 5 modes (Off/1/2/3/Auto)");

    while (1) {
        refresh_temp_sources();
        safety_tick();
        update_cooling();
        k_sleep(K_MSEC(CONTROL_INTERVAL_MS));
    }
}
```

## src/auto_mode.c
```c
#include <zephyr/kernel.h>
#include "auto_mode.h"
#include "levels.h"

static float target_temp = AUTO_TARGET_DEFAULT;
static float current_temp = 0.0f;
static bool peltier_on = false;

void auto_mode_init(void)
{
    target_temp = AUTO_TARGET_DEFAULT;
    current_temp = 0.0f;
    peltier_on = false;
}

void auto_mode_set_target(float temp_c)
{
    if (temp_c < AUTO_TARGET_MIN) {
        temp_c = AUTO_TARGET_MIN;
    }
    if (temp_c > AUTO_TARGET_MAX) {
        temp_c = AUTO_TARGET_MAX;
    }
    target_temp = temp_c;
}

float auto_mode_get_target(void)
{
    return target_temp;
}

bool auto_mode_tick(float current)
{
    current_temp = current;

    if (current_temp > target_temp + AUTO_HYSTERESIS) {
        peltier_on = true;
    } else if (current_temp < target_temp - AUTO_HYSTERESIS) {
        peltier_on = false;
    }

    return peltier_on;
}
```

## src/auto_mode.h
```c
#ifndef AUTO_MODE_H
#define AUTO_MODE_H

#include <stdbool.h>

void auto_mode_init(void);
void auto_mode_set_target(float temp_c);
float auto_mode_get_target(void);
bool auto_mode_tick(float current_temp);

#endif
```

## src/ble_patch.c
```c
#include <zephyr/kernel.h>
#include <zephyr/bluetooth/bluetooth.h>
#include <zephyr/bluetooth/conn.h>
#include <zephyr/bluetooth/uuid.h>
#include <zephyr/bluetooth/gatt.h>

#include "ble_patch.h"

#define PATCH_NAME "CryoPatch"

static struct bt_conn *patch_conn = NULL;
static float patch_temp = 0.0f;
static bool has_temp = false;

static void device_found(const bt_addr_le_t *addr, int8_t rssi,
                         uint8_t type, struct net_buf_simple *ad)
{
    if (patch_conn != NULL) {
        return;
    }

    struct bt_data *data;
    struct net_buf_simple buf;

    net_buf_simple_init(&buf, ad->data);
    while (buf.len > 1) {
        uint8_t len = net_buf_simple_pull_u8(&buf);
        if (len == 0 || len > buf.len) break;
        uint8_t type = net_buf_simple_pull_u8(&buf);
        if (type == BT_DATA_NAME_SHORTENED || type == BT_DATA_NAME_COMPLETE) {
            if (buf.len >= sizeof(PATCH_NAME) - 1 &&
                memcmp(buf.data, PATCH_NAME, sizeof(PATCH_NAME) - 1) == 0) {
                bt_le_scan_stop();
                bt_conn_le_create(addr, BT_CONN_LE_CREATE_CONN,
                                  BT_LE_CONN_PARAM_DEFAULT, &patch_conn);
                return;
            }
        }
        net_buf_simple_pull(&buf, len - 1);
    }
}

void ble_patch_init(void)
{
    struct bt_le_scan_param scan_param = {
        .type = BT_LE_SCAN_TYPE_ACTIVE,
        .interval = 0x0060,
        .window = 0x0030,
    };
    bt_le_scan_start(&scan_param, device_found);
}

int ble_patch_get_temp(float *temp)
{
    if (!has_temp) {
        return -1;
    }
    *temp = patch_temp;
    return 0;
}

bool ble_patch_is_connected(void)
{
    return patch_conn != NULL;
}
```

## src/ble_patch.h
```c
#ifndef BLE_PATCH_H
#define BLE_PATCH_H

void ble_patch_init(void);
int ble_patch_get_temp(float *temp);
bool ble_patch_is_connected(void);

#endif
```

## src/ble_phone.c
```c
#include <zephyr/kernel.h>
#include <zephyr/bluetooth/bluetooth.h>
#include <zephyr/bluetooth/conn.h>
#include <zephyr/bluetooth/uuid.h>
#include <zephyr/bluetooth/gatt.h>

#include "ble_phone.h"
#include "levels.h"

static struct bt_conn *phone_conn = NULL;
static float phone_temp = 0.0f;
static bool has_temp = false;

static int cooler_mode = MODE_OFF;
static int target_temp = AUTO_TARGET_DEFAULT;

static ssize_t on_write_mode(struct bt_conn *conn,
                              const struct bt_gatt_attr *attr,
                              const void *buf, uint16_t len,
                              uint16_t offset, uint8_t flags)
{
    if (offset != 0 || len != 1) {
        return BT_GATT_ERR(BT_ATT_ERR_INVALID_OFFSET);
    }
    uint8_t val = *((const uint8_t *)buf);
    if (val <= MODE_AUTO) {
        cooler_mode = val;
    }
    return len;
}

static ssize_t on_write_target(struct bt_conn *conn,
                                const struct bt_gatt_attr *attr,
                                const void *buf, uint16_t len,
                                uint16_t offset, uint8_t flags)
{
    if (offset != 0 || len != 1) {
        return BT_GATT_ERR(BT_ATT_ERR_INVALID_OFFSET);
    }
    uint8_t val = *((const uint8_t *)buf);
    if (val >= AUTO_TARGET_MIN && val <= AUTO_TARGET_MAX) {
        target_temp = val;
    }
    return len;
}

BT_GATT_SERVICE_DEFINE(cooler_ctrl_svc,
    BT_GATT_PRIMARY_SERVICE(BT_UUID_DECLARE_128(
        BT_UUID_128_ENCODE(0x0000cry0, 0x0000, 0x1000, 0x8000, 0x00805f9b34fb))),

    BT_GATT_CHARACTERISTIC(BT_UUID_DECLARE_128(
        BT_UUID_128_ENCODE(0x0000cry1, 0x0000, 0x1000, 0x8000, 0x00805f9b34fb)),
        BT_GATT_CHRC_WRITE,
        BT_GATT_PERM_WRITE,
        NULL, on_write_mode, NULL),

    BT_GATT_CHARACTERISTIC(BT_UUID_DECLARE_128(
        BT_UUID_128_ENCODE(0x0000cry2, 0x0000, 0x1000, 0x8000, 0x00805f9b34fb)),
        BT_GATT_CHRC_WRITE,
        BT_GATT_PERM_WRITE,
        NULL, on_write_target, NULL),
);

void ble_phone_init(void)
{
    const struct bt_data ad[] = {
        BT_DATA_BYTES(BT_DATA_FLAGS, BT_LE_AD_GENERAL | BT_LE_AD_NO_BREDR),
        BT_DATA(BT_DATA_NAME_COMPLETE, "CryoCooler", sizeof("CryoCooler") - 1),
    };
    bt_le_adv_start(BT_LE_ADV_CONN, ad, ARRAY_SIZE(ad), NULL, 0);
}

int ble_phone_get_temp(float *temp)
{
    if (!has_temp) {
        return -1;
    }
    *temp = phone_temp;
    return 0;
}

bool ble_phone_is_connected(void)
{
    return phone_conn != NULL;
}

int ble_phone_get_mode(void)
{
    return cooler_mode;
}

int ble_phone_get_target_temp(void)
{
    return target_temp;
}
```

## src/ble_phone.h
```c
#ifndef BLE_PHONE_H
#define BLE_PHONE_H

void ble_phone_init(void);
int ble_phone_get_temp(float *temp);
bool ble_phone_is_connected(void);
int ble_phone_get_mode(void);
int ble_phone_get_target_temp(void);

#endif
```

## src/levels.h
```c
#ifndef LEVELS_H
#define LEVELS_H

#define LEVEL_0_OFF     0
#define LEVEL_1_MILD    1
#define LEVEL_2_ACTIVE  2
#define LEVEL_3_MAX     3

#define PWM_LEVEL_0     0
#define PWM_LEVEL_1     33
#define PWM_LEVEL_2     66
#define PWM_LEVEL_3     100

#define MAX_CYCLE_MIN   15

#define MODE_OFF    0
#define MODE_L1     1
#define MODE_L2     2
#define MODE_L3     3
#define MODE_AUTO   4

#define AUTO_TARGET_MIN     10
#define AUTO_TARGET_MAX     25
#define AUTO_TARGET_DEFAULT 15
#define AUTO_HYSTERESIS     1.0f

#endif
```

## src/peltier.c
```c
#include <zephyr/kernel.h>
#include <zephyr/drivers/pwm.h>
#include "peltier.h"
#include "levels.h"

static const struct device *pwm_dev;
static int current_level = LEVEL_0_OFF;

#define PWM_NODE DT_ALIAS(pwm_peltier)
#define PWM_PERIOD PWM_USEC(20000)

void peltier_init(void)
{
    pwm_dev = DEVICE_DT_GET(PWM_NODE);
    if (!device_is_ready(pwm_dev)) {
        printk("PWM device not ready\n");
        return;
    }
    peltier_off();
}

void peltier_set_level(int level)
{
    uint32_t duty = 0;

    switch (level) {
    case LEVEL_0_OFF:
        duty = 0;
        break;
    case LEVEL_1_MILD:
        duty = PWM_PERIOD * PWM_LEVEL_1 / 100;
        break;
    case LEVEL_2_ACTIVE:
        duty = PWM_PERIOD * PWM_LEVEL_2 / 100;
        break;
    case LEVEL_3_MAX:
        duty = PWM_PERIOD * PWM_LEVEL_3 / 100;
        break;
    default:
        duty = 0;
        break;
    }

    pwm_set(pwm_dev, 0, PWM_PERIOD, duty);
    current_level = level;
}

void peltier_off(void)
{
    peltier_set_level(LEVEL_0_OFF);
}

int peltier_get_level(void)
{
    return current_level;
}
```

## src/peltier.h
```c
#ifndef PELTIER_H
#define PELTIER_H

void peltier_init(void);
void peltier_set_level(int level);
void peltier_off(void);
int peltier_get_level(void);

#endif
```

## src/safety.c
```c
#include <zephyr/kernel.h>
#include "safety.h"
#include "levels.h"

#define RUN_TIMER_MS (MAX_CYCLE_MIN * 60 * 1000)

static bool faulted = false;
static bool timer_exp = false;
static int64_t start_time = 0;
static const char *fault_reason = "none";

void safety_init(void)
{
    faulted = false;
    timer_exp = false;
    start_time = 0;
    fault_reason = "none";
}

void safety_tick(void)
{
    if (start_time == 0) {
        return;
    }

    int64_t elapsed = k_uptime_get() - start_time;
    if (elapsed >= RUN_TIMER_MS) {
        timer_exp = true;
        faulted = true;
        fault_reason = "max runtime exceeded";
    }
}

bool safety_is_faulted(void)
{
    return faulted;
}

bool safety_timer_expired(void)
{
    return timer_exp;
}

void safety_reset_timer(void)
{
    start_time = k_uptime_get();
    timer_exp = false;
}

const char *safety_get_fault_reason(void)
{
    return fault_reason;
}
```

## src/safety.h
```c
#ifndef SAFETY_H
#define SAFETY_H

#include <stdbool.h>

void safety_init(void);
void safety_tick(void);
bool safety_is_faulted(void);
bool safety_timer_expired(void);
void safety_reset_timer(void);
const char *safety_get_fault_reason(void);

#endif
```

## src/temp_voter.c
```c
#include <zephyr/kernel.h>
#include "temp_voter.h"

static struct temp_reading sources[NUM_TEMP_SOURCES];
static const float VOTE_TOLERANCE = 0.5;

void temp_voter_init(void)
{
    for (int i = 0; i < NUM_TEMP_SOURCES; i++) {
        sources[i].temperature = 0.0f;
        sources[i].valid = false;
        sources[i].timestamp = 0;
    }
}

void temp_voter_feed(int source, float temp)
{
    if (source >= 0 && source < NUM_TEMP_SOURCES) {
        sources[source].temperature = temp;
        sources[source].valid = true;
        sources[source].timestamp = k_uptime_get();
    }
}

struct temp_vote_result temp_voter_get_vote(void)
{
    struct temp_vote_result result = {0};
    int valid_count = 0;
    int best_count = 0;
    float best_temp = 0;

    for (int i = 0; i < NUM_TEMP_SOURCES; i++) {
        if (sources[i].valid) {
            valid_count++;
            int matches = 0;
            for (int j = 0; j < NUM_TEMP_SOURCES; j++) {
                if (i != j && sources[j].valid) {
                    float diff = sources[i].temperature - sources[j].temperature;
                    if (diff < 0) diff = -diff;
                    if (diff <= VOTE_TOLERANCE) {
                        matches++;
                    }
                }
            }
            if (matches > best_count) {
                best_count = matches;
                best_temp = sources[i].temperature;
            }
        }
    }

    result.sources_agreeing = best_count + 1;
    result.temperature = best_temp;
    result.safe = (valid_count >= 2 && result.sources_agreeing >= 2);

    return result;
}

bool temp_voter_has_quorum(void)
{
    return temp_voter_get_vote().safe;
}
```
